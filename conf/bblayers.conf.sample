## conf/distro/include/nitrogen6x.conf
```bitbake
############################################################################
##
## Copyright (C) 2016 The Qt Company Ltd.
## Contact: https://www.qt.io/licensing/
##
## This file is part of the Boot to Qt meta layer.
##
## $QT_BEGIN_LICENSE:GPL$
## Commercial License Usage
## Licensees holding valid commercial Qt licenses may use this file in
## accordance with the commercial license agreement provided with the
## Software or, alternatively, in accordance with the terms contained in
## a written agreement between you and The Qt Company. For licensing terms
## and conditions see https://www.qt.io/terms-conditions. For further
## information use the contact form at https://www.qt.io/contact-us.
##
## GNU General Public License Usage
## Alternatively, this file may be used under the terms of the GNU
## General Public License version 3 or (at your option) any later version
## approved by the KDE Free Qt Foundation. The licenses are as published by
## the Free Software Foundation and appearing in the file LICENSE.GPL3
## included in the packaging of this file. Please review the following
## information to ensure the GNU General Public License requirements will
## be met: https://www.gnu.org/licenses/gpl-3.0.html.
##
## $QT_END_LICENSE$
##
############################################################################

include conf/distro/include/imx6.inc
include conf/distro/include/imx6-egl.inc
include conf/distro/include/imx6-opencv.inc

DEPLOY_CONF_NAME = "Boundary Devices i.MX6"

BOOTFS_CONTENT = "\
    ${KERNEL_IMAGETYPE}:${KERNEL_IMAGETYPE} \
    ${KERNEL_IMAGETYPE}-imx6q-${MACHINE}.dtb:imx6q-${MACHINE}.dtb \
    ${KERNEL_IMAGETYPE}-imx6dl-${MACHINE}.dtb:imx6dl-${MACHINE}.dtb \
    ${KERNEL_IMAGETYPE}-imx6q-sabrelite.dtb:imx6q-sabrelite.dtb \
    ${KERNEL_IMAGETYPE}-imx6dl-nit6xlite.dtb:imx6dl-nit6xlite.dtb \
    ${KERNEL_IMAGETYPE}-imx6q-nitrogen6_max.dtb:imx6q-nitrogen6_max.dtb \
    6x_bootscript-${MACHINE}:6x_bootscript \
    6x_upgrade-${MACHINE}:6x_upgrade \
    u-boot-${MACHINE}.imx:u-boot.imx \
    "
BOOTFS_DEPENDS = "u-boot:do_deploy virtual/kernel:do_deploy u-boot-script-boundary:do_deploy"
BOOT_SPACE = "16384"
BOOT_SCRIPTS += "6x_upgrade-${MACHINE}:6x_upgrade \
                 u-boot-nit6xlite-*.imx:u-boot.nit6xlite \
                 u-boot-nit6xlite1g-*.imx:u-boot.nit6xlite1g \
                 u-boot-nitrogen6dl-*.imx:u-boot.nitrogen6dl \
                 u-boot-nitrogen6dl2g-*.imx:u-boot.nitrogen6dl2g \
                 u-boot-nitrogen6q2g-*.imx:u-boot.nitrogen6q2g \
                 u-boot-nitrogen6q-*.imx:u-boot.nitrogen6q \
                 u-boot-nitrogen6q_fl-*.imx:u-boot.nitrogen6q_fl \
                 u-boot-nitrogen6qp_max-*.imx:u-boot.nitrogen6qp_max \
                 u-boot-nitrogen6s1g-*.imx:u-boot.nitrogen6s1g \
                 u-boot-nitrogen6s-*.imx:u-boot.nitrogen6s \
                 u-boot-nitrogen6sx-*.imx:u-boot.nitrogen6sx \
                 u-boot-nitrogen6_lum_dl1-*.imx:u-boot.nitrogen6_lum_dl1 \
                 u-boot-nitrogen6_max-*.imx:u-boot.nitrogen6_max \
                 u-boot-nitrogen6_vm1g-*.imx:u-boot.nitrogen6_vm1g \
                 u-boot-nitrogen6_vm-*.imx:u-boot.nitrogen6_vm \
                "

UBOOT_MACHINE = ""
UBOOT_CONFIG ??= "nit6xlite nit6xlite1g \
                  nitrogen6dl nitrogen6dl2g \
                  nitrogen6q2g nitrogen6q nitrogen6q_fl nitrogen6qp_max \
                  nitrogen6s1g nitrogen6s nitrogen6sx \
                  nitrogen6_lum_dl1 nitrogen6_max \
                  nitrogen6_vm1g nitrogen6_vm \
                 "

UBOOT_CONFIG[nit6xlite] = "nit6xlite_config"
UBOOT_CONFIG[nit6xlite1g] = "nit6xlite1g_config"
UBOOT_CONFIG[nitrogen6dl] = "nitrogen6dl_config"
UBOOT_CONFIG[nitrogen6dl2g] = "nitrogen6dl2g_config"
UBOOT_CONFIG[nitrogen6q2g] = "nitrogen6q2g_config"
UBOOT_CONFIG[nitrogen6q] = "nitrogen6q_config"
UBOOT_CONFIG[nitrogen6q_fl] = "nitrogen6q_fl_config"
UBOOT_CONFIG[nitrogen6qp_max] = "nitrogen6qp_max_config"
UBOOT_CONFIG[nitrogen6s1g] = "nitrogen6s1g_config"
UBOOT_CONFIG[nitrogen6s] = "nitrogen6s_config"
UBOOT_CONFIG[nitrogen6sx] = "nitrogen6sx_config"
UBOOT_CONFIG[nitrogen6_lum_dl1] = "nitrogen6_lum_dl1_config"
UBOOT_CONFIG[nitrogen6_max] = "nitrogen6_max_config"
UBOOT_CONFIG[nitrogen6_vm1g] = "nitrogen6_vm1g_config"
UBOOT_CONFIG[nitrogen6_vm] = "nitrogen6_vm_config"

EXTRA_IMAGEDEPENDS += "u-boot-script-boundary"

KERNEL_DEVICETREE += "imx6dl-nit6xlite.dtb"

DISTRO_FEATURES_DEFAULT += "wayland"

MACHINE_EXTRA_INSTALL = "\
        bcm4330-nvram-config \
        "

ADB_PRODUCTID = "0x0d02"
```

## conf/distro/include/nvidia-logan.conf
```bitbake
############################################################################
##
## Copyright (C) 2016 The Qt Company Ltd.
## Contact: https://www.qt.io/licensing/
##
## This file is part of the Boot to Qt meta layer.
##
## $QT_BEGIN_LICENSE:GPL$
## Commercial License Usage
## Licensees holding valid commercial Qt licenses may use this file in
## accordance with the commercial license agreement provided with the
## Software or, alternatively, in accordance with the terms contained in
## a written agreement between you and The Qt Company. For licensing terms
## and conditions see https://www.qt.io/terms-conditions. For further
## information use the contact form at https://www.qt.io/contact-us.
##
## GNU General Public License Usage
## Alternatively, this file may be used under the terms of the GNU
## General Public License version 3 or (at your option) any later version
## approved by the KDE Free Qt Foundation. The licenses are as published by
## the Free Software Foundation and appearing in the file LICENSE.GPL3
## included in the packaging of this file. Please review the following
## information to ensure the GNU General Public License requirements will
## be met: https://www.gnu.org/licenses/gpl-3.0.html.
##
## $QT_END_LICENSE$
##
############################################################################

TARGET_CFLAGS += " -DWIN_INTERFACE_CUSTOM"

DEFAULTTUNE = "cortexa15hf-neon"

KERN_DIR ?= '${@os.path.normpath("${TOPDIR}/../sources/jetson-tk1-pro/vibrante-vcm30t124-linux")}'
PLATFORM_TOPDIR ?= '${@os.path.normpath("${TOPDIR}/../sources/jetson-tk1-pro/vibrante-vcm30t124-linux")}'
NVLAYER_DIR ?= "${TOPDIR}/../sources/nvidia-layer"

MACHINE_EXTRA_INSTALL = "\
        libegl \
        libgles2 \
        tegra-firmware-gk20a \
        graphics-fw \
        libdrm-nv \
"

MACHINE_EXTRA_INSTALL_SDK = "\
        libegl-dev \
        libgles2-dev \
        graphics-headers-dev \
        libdrm-nv-dev \
"

PREFERRED_PROVIDER_libdrm ?= "libdrm-nv"
PREFERRED_PROVIDER_drm ?= "libdrm-nv"

BBMASK ?= " "
BBMASK .= "\
|meta-vib3/recipes-kernel/linux-libc-headers\
|meta-vib3/recipes-devtools/binutils\
|meta-vib3/recipes-core/eglibc\
|meta-vib3/recipes-core/systemd\
|meta-vib3/recipes-connectivity\
|meta-vib3/recipes-multimedia/pulseaudio\
|meta-vib3/recipes-core/meta/external-tegra-toolchain.bb\
|meta-vib3/recipes-core/packagegroups\
"
```

## conf/distro/include/raspberrypi.conf
```bitbake
##############################################################################
##
## Copyright (C) 2016 The Qt Company Ltd.
## Contact: http://www.qt.io/licensing/
##
## This file is part of the Boot to Qt meta layer.
##
## $QT_BEGIN_LICENSE:COMM$
##
## Commercial License Usage
## Licensees holding valid commercial Qt licenses may use this file in
## accordance with the commercial license agreement provided with the
## Software or, alternatively, in accordance with the terms contained in
## a written agreement between you and The Qt Company. For licensing terms
## and conditions see http://www.qt.io/terms-conditions. For further
## information use the contact form at http://www.qt.io/contact-us.
##
## $QT_END_LICENSE$
##
##############################################################################

DEPLOY_CONF_NAME = "Raspberry Pi"

IMAGE_FSTYPES += "ext3 rpi-sdimg"

BOOTFS_CONTENT = "\
    bcm2835-bootfiles/*: \
    ${KERNEL_IMAGETYPE}:kernel.img \
    "
BOOTFS_DEPENDS = "bcm2835-bootfiles:do_deploy virtual/kernel:do_deploy"

PREFERRED_PROVIDER_virtual/libgles1 = "userland"

DISTRO_FEATURES_remove = "webengine"

MACHINE_EXTRA_INSTALL = "\
        userland \
        "

MACHINE_EXTRA_INSTALL_SDK = " \
        userland-dev \
        "

KERNEL_MODULE_AUTOLOAD += "snd-bcm2835 bcm2835-v4l2"
KERNEL_MODULE_PROBECONF += "bcm2835-v4l2"
module_conf_bcm2835-v4l2 = "options bcm2835-v4l2 gst_v4l2src_is_broken=1"

# additional memory for GPU
GPU_MEM = "128"
# video camera support
VIDEO_CAMERA = "1"
```

## conf/distro/include/raspberrypi.inc
```bitbake
############################################################################
##
## Copyright (C) 2016 The Qt Company Ltd.
## Contact: https://www.qt.io/licensing/
##
## This file is part of the Boot to Qt meta layer.
##
## $QT_BEGIN_LICENSE:GPL$
## Commercial License Usage
## Licensees holding valid commercial Qt licenses may use this file in
## accordance with the commercial license agreement provided with the
## Software or, alternatively, in accordance with the terms contained in
## a written agreement between you and The Qt Company. For licensing terms
## and conditions see https://www.qt.io/terms-conditions. For further
## information use the contact form at https://www.qt.io/contact-us.
##
## GNU General Public License Usage
## Alternatively, this file may be used under the terms of the GNU
## General Public License version 3 or (at your option) any later version
## approved by the KDE Free Qt Foundation. The licenses are as published by
## the Free Software Foundation and appearing in the file LICENSE.GPL3
## included in the packaging of this file. Please review the following
## information to ensure the GNU General Public License requirements will
## be met: https://www.gnu.org/licenses/gpl-3.0.html.
##
## $QT_END_LICENSE$
##
############################################################################

IMAGE_FSTYPES += "ext3 rpi-sdimg"

BOOTFS_CONTENT = "\
    bcm2835-bootfiles/*: \
    ${KERNEL_IMAGETYPE}:kernel.img \
    "

BOOTFS_DEPENDS = "bcm2835-bootfiles:do_deploy virtual/kernel:do_deploy"

MACHINE_EXTRA_INSTALL_SDK = " \
        userland-dev \
        "

MACHINE_EXTRA_INSTALL = "\
        userland \
        omxplayer \
        "

KERNEL_MODULE_AUTOLOAD += "snd-bcm2835 bcm2835-v4l2"
KERNEL_MODULE_PROBECONF += "bcm2835-v4l2"
module_conf_bcm2835-v4l2 = "options bcm2835-v4l2 gst_v4l2src_is_broken=1"

# video camera support
VIDEO_CAMERA = "1"

RPI_FT5604 = "1"
KERNEL_DEVICETREE += "overlays/rpi-ft5406-overlay.dtb"
MACHINE_FEATURES += "pitft"
```

## conf/distro/include/raspberrypi2.conf
```bitbake
#############################################################################
##
## Copyright (C) 2014 Digia Plc and/or its subsidiary(-ies).
##
## This file is part of the Qt Enterprise Embedded Scripts of the Qt
## framework.
##
## $QT_BEGIN_LICENSE$
## Commercial License Usage Only
## Licensees holding valid commercial Qt license agreements with Digia
## with an appropriate addendum covering the Qt Enterprise Embedded Scripts,
## may use this file in accordance with the terms contained in said license
## agreement.
##
## For further information use the contact form at
## http://www.qt.io/contact-us.
##
##
## $QT_END_LICENSE$
##
#############################################################################

IMAGE_FSTYPES += "ext3 rpi-sdimg"

BOOTFS_CONTENT = "\
    bcm2835-bootfiles/*: \
    ${KERNEL_IMAGETYPE}:kernel.img \
    "
BOOTFS_DEPENDS = "bcm2835-bootfiles:do_deploy virtual/kernel:do_deploy"

MACHINE_EXTRA_INSTALL = "\
        userland \
        omxplayer \
        "

MACHINE_EXTRA_INSTALL_SDK = " \
        userland \
        "

KERNEL_MODULE_AUTOLOAD += "snd-bcm2835 bcm2835-v4l2"
KERNEL_MODULE_PROBECONF += "bcm2835-v4l2"
module_conf_bcm2835-v4l2 = "options bcm2835-v4l2 gst_v4l2src_is_broken=1"

# additional memory for GPU
GPU_MEM = "256"
# video camera support
VIDEO_CAMERA = "1"
```
