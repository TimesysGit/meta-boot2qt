## conf/distro/include/colibri-vf.conf
```bitbake
############################################################################
##
## Copyright (C) 2016 The Qt Company Ltd.
## Contact: https://www.qt.io/licensing/
##
## This file is part of the Boot to Qt meta layer.
##
## $QT_BEGIN_LICENSE:GPL$
## Commercial License Usage
## Licensees holding valid commercial Qt licenses may use this file in
## accordance with the commercial license agreement provided with the
## Software or, alternatively, in accordance with the terms contained in
## a written agreement between you and The Qt Company. For licensing terms
## and conditions see https://www.qt.io/terms-conditions. For further
## information use the contact form at https://www.qt.io/contact-us.
##
## GNU General Public License Usage
## Alternatively, this file may be used under the terms of the GNU
## General Public License version 3 or (at your option) any later version
## approved by the KDE Free Qt Foundation. The licenses are as published by
## the Free Software Foundation and appearing in the file LICENSE.GPL3
## included in the packaging of this file. Please review the following
## information to ensure the GNU General Public License requirements will
## be met: https://www.gnu.org/licenses/gpl-3.0.html.
##
## $QT_END_LICENSE$
##
############################################################################

include conf/distro/include/toradex.inc

DEPLOY_CONF_NAME = "Toradex Colibri VF"

IMAGE_FSTYPES += "ext3 sdcard"
IMAGE_ROOTFS_ALIGNMENT_colibri-vf = "1024"

BOOTFS_CONTENT = "\
    u-boot-${MACHINE}.imx:u-boot.imx \
    flash_mmc-${MACHINE}.img:flash_mmc.img \
    flash_blk-${MACHINE}.img:flash_blk.img \
    ${KERNEL_IMAGETYPE}-vf500-colibri-eval-v3.dtb:vf500-colibri-eval-v3.dtb \
    ${KERNEL_IMAGETYPE}-vf610-colibri-eval-v3.dtb:vf610-colibri-eval-v3.dtb \
    "
BOOTFS_DEPENDS = "u-boot:do_deploy u-boot-script-toradex:do_deploy virtual/kernel:do_deploy"
BOOT_SCRIPTS += " \
    u-boot-${MACHINE}.imx:u-boot.imx \
    flash_mmc-${MACHINE}.img:flash_mmc.img \
    flash_blk-${MACHINE}.img:flash_blk.img \
    "

DEFAULTTUNE = "armv7ahf-neon"

PREFERRED_PROVIDER_virtual/egl = "opengldummy"
PREFERRED_PROVIDER_virtual/libgles2 = "opengldummy"

DISTRO_FEATURES_remove = "webengine"

MACHINE_EXTRA_INSTALL = "\
        opengldummy \
        mqxboot \
        "

MACHINE_EXTRA_INSTALL_SDK = "\
        opengldummy-dev \
        "
```

## conf/distro/include/emulator.conf
```bitbake
############################################################################
##
## Copyright (C) 2016 The Qt Company Ltd.
## Contact: https://www.qt.io/licensing/
##
## This file is part of the Boot to Qt meta layer.
##
## $QT_BEGIN_LICENSE:GPL$
## Commercial License Usage
## Licensees holding valid commercial Qt licenses may use this file in
## accordance with the commercial license agreement provided with the
## Software or, alternatively, in accordance with the terms contained in
## a written agreement between you and The Qt Company. For licensing terms
## and conditions see https://www.qt.io/terms-conditions. For further
## information use the contact form at https://www.qt.io/contact-us.
##
## GNU General Public License Usage
## Alternatively, this file may be used under the terms of the GNU
## General Public License version 3 or (at your option) any later version
## approved by the KDE Free Qt Foundation. The licenses are as published by
## the Free Software Foundation and appearing in the file LICENSE.GPL3
## included in the packaging of this file. Please review the following
## information to ensure the GNU General Public License requirements will
## be met: https://www.gnu.org/licenses/gpl-3.0.html.
##
## $QT_END_LICENSE$
##
############################################################################

IMAGE_CLASSES += "image-hdd"
IMAGE_ROOTFS_ALIGNMENT = "1048576"
ROOTFS ?= "${DEPLOY_DIR_IMAGE}/${IMAGE_BASENAME}-${MACHINE}.ext3"
IMAGE_FSTYPES = "ext3"

MACHINE_EXTRA_RRECOMMENDS += "\
        kernel-module-snd-intel8x0 \
        "

PREFERRED_PROVIDER_virtual/egl = "qtglesstream-dummy-client"
PREFERRED_PROVIDER_virtual/libgles2 = "qtglesstream-dummy-client"

KERNEL_MODULE_AUTOLOAD += "snd-intel8x0 vboxguest vboxsf"

DISTRO_FEATURES_remove = "webengine opengl"

MACHINE_EXTRA_INSTALL = "\
        mount-vboxsf \
        "
MACHINE_EXTRA_INSTALL_SDK = "\
        qtglesstream-dummy-client-dev \
        "
MACHINE_EXTRA_INSTALL_QT = "\
        qtsystems \
        qtglesstream \
        b2qt-emulator-proxy \
        b2qt-emulator-vinput \
        b2qt-emulator-sdcardmountd \
        "
MACHINE_EXTRA_INSTALL_QT_SDK = "\
        qtglesstream-dev \
        "
```

## conf/distro/include/image_type.conf
```bitbake
IMAGE_FSTYPES = "tar.gz ext3 sdcard"
IMAGE_CLASSES += "image_types_sdcard"

IMAGE_ROOTFS_EXTRA_SPACE = "300000"
SDCARD_ROOTFS = "${DEPLOY_DIR_IMAGE}/${IMAGE_NAME}.rootfs.ext3"
```

## conf/distro/include/imx53qsb.conf
```bitbake
##############################################################################
##
## Copyright (C) 2016 The Qt Company Ltd.
## Contact: http://www.qt.io/licensing/
##
## This file is part of the Boot to Qt meta layer.
##
## $QT_BEGIN_LICENSE:COMM$
##
## Commercial License Usage
## Licensees holding valid commercial Qt licenses may use this file in
## accordance with the commercial license agreement provided with the
## Software or, alternatively, in accordance with the terms contained in
## a written agreement between you and The Qt Company. For licensing terms
## and conditions see http://www.qt.io/terms-conditions. For further
## information use the contact form at http://www.qt.io/contact-us.
##
## $QT_END_LICENSE$
##
##############################################################################

include conf/distro/include/imx6.inc

DEPLOY_CONF_NAME = "Freescale iMX53 Quick Start Board"

BOOTFS_CONTENT = "\
    u-boot-${MACHINE}.${UBOOT_SUFFIX}:u-boot.${UBOOT_SUFFIX} \
    ${KERNEL_IMAGETYPE}:${KERNEL_IMAGETYPE} \
    "
BOOTFS_DEPENDS = "u-boot:do_deploy virtual/kernel:do_deploy"

DISTRO_FEATURES_remove = "webengine"

MACHINE_EXTRA_INSTALL = "\
        amd-gpu-bin-mx51 \
        "

MACHINE_EXTRA_INSTALL_SDK = " \
        libgsl-fsl-mx51-dev \
        libegl-mx51-dev \
        libgles2-mx51-dev \
        "
```

## conf/distro/include/imx6.inc
```bitbake
##############################################################################
##
## Copyright (C) 2016 The Qt Company Ltd.
## Contact: http://www.qt.io/licensing/
##
## This file is part of the Boot to Qt meta layer.
##
## $QT_BEGIN_LICENSE:COMM$
##
## Commercial License Usage
## Licensees holding valid commercial Qt licenses may use this file in
## accordance with the commercial license agreement provided with the
## Software or, alternatively, in accordance with the terms contained in
## a written agreement between you and The Qt Company. For licensing terms
## and conditions see http://www.qt.io/terms-conditions. For further
## information use the contact form at http://www.qt.io/contact-us.
##
## $QT_END_LICENSE$
##
##############################################################################

BBMASK ?= " "
BBMASK .= "|meta-fsl-arm/qt5-layer/recipes-qt/qt5"

IMAGE_FSTYPES += "ext3 sdcard"

MACHINE_EXTRA_INSTALL_SDK = " \
        ${@base_contains("DISTRO_FEATURES", "wayland", "libwayland-egl-mx6-dev", "", d)} \
        "
```

## conf/distro/include/imx6qsabresd.conf
```bitbake
############################################################################
##
## Copyright (C) 2016 The Qt Company Ltd.
## Contact: https://www.qt.io/licensing/
##
## This file is part of the Boot to Qt meta layer.
##
## $QT_BEGIN_LICENSE:GPL$
## Commercial License Usage
## Licensees holding valid commercial Qt licenses may use this file in
## accordance with the commercial license agreement provided with the
## Software or, alternatively, in accordance with the terms contained in
## a written agreement between you and The Qt Company. For licensing terms
## and conditions see https://www.qt.io/terms-conditions. For further
## information use the contact form at https://www.qt.io/contact-us.
##
## GNU General Public License Usage
## Alternatively, this file may be used under the terms of the GNU
## General Public License version 3 or (at your option) any later version
## approved by the KDE Free Qt Foundation. The licenses are as published by
## the Free Software Foundation and appearing in the file LICENSE.GPL3
## included in the packaging of this file. Please review the following
## information to ensure the GNU General Public License requirements will
## be met: https://www.gnu.org/licenses/gpl-3.0.html.
##
## $QT_END_LICENSE$
##
############################################################################

include conf/distro/include/imx6.inc
include conf/distro/include/imx6-egl.inc
include conf/distro/include/imx6-opencv.inc

DEPLOY_CONF_NAME = "Freescale SABRE SD i.MX6Quad"

BOOTFS_CONTENT = "\
    ${KERNEL_IMAGETYPE}:${KERNEL_IMAGETYPE} \
    ${KERNEL_IMAGETYPE}-imx6q-sabresd.dtb:imx6q-sabresd.dtb \
    ${KERNEL_IMAGETYPE}-imx6q-sabresd-hdcp.dtb:imx6q-sabresd-hdcp.dtb \
    ${KERNEL_IMAGETYPE}-imx6q-sabresd-ldo.dtb:imx6q-sabresd-ldo.dtb \
    ${KERNEL_IMAGETYPE}-imx6dl-sabresd.dtb:imx6dl-sabresd.dtb \
    ${KERNEL_IMAGETYPE}-imx6dl-sabresd-hdcp.dtb:imx6dl-sabresd-hdcp.dtb \
    ${KERNEL_IMAGETYPE}-imx6dl-sabresd-ldo.dtb:imx6dl-sabresd-ldo.dtb \
    u-boot-${MACHINE}.imx:u-boot.imx \
    "
BOOTFS_DEPENDS = "u-boot:do_deploy virtual/kernel:do_deploy"

DISTRO_FEATURES_DEFAULT += "wayland"

KERNEL_MODULE_AUTOLOAD += "mxc_v4l2_capture"

# add support for both imx6qsabresd and imx6dlsabresd
KERNEL_DEVICETREE = "imx6q-sabresd.dtb imx6q-sabresd-ldo.dtb imx6q-sabresd-hdcp.dtb \
                     imx6dl-sabresd.dtb imx6dl-sabresd-ldo.dtb imx6dl-sabresd-hdcp.dtb \
                    "
MACHINE_FIRMWARE_append = " firmware-imx-vpu-imx6q firmware-imx-vpu-imx6d"
```

## conf/distro/include/imx7dsabresd.conf
```bitbake
############################################################################
##
## Copyright (C) 2016 The Qt Company Ltd.
## Contact: https://www.qt.io/licensing/
##
## This file is part of the Boot to Qt meta layer.
##
## $QT_BEGIN_LICENSE:GPL$
## Commercial License Usage
## Licensees holding valid commercial Qt licenses may use this file in
## accordance with the commercial license agreement provided with the
## Software or, alternatively, in accordance with the terms contained in
## a written agreement between you and The Qt Company. For licensing terms
## and conditions see https://www.qt.io/terms-conditions. For further
## information use the contact form at https://www.qt.io/contact-us.
##
## GNU General Public License Usage
## Alternatively, this file may be used under the terms of the GNU
## General Public License version 3 or (at your option) any later version
## approved by the KDE Free Qt Foundation. The licenses are as published by
## the Free Software Foundation and appearing in the file LICENSE.GPL3
## included in the packaging of this file. Please review the following
## information to ensure the GNU General Public License requirements will
## be met: https://www.gnu.org/licenses/gpl-3.0.html.
##
## $QT_END_LICENSE$
##
############################################################################

DEPLOY_CONF_NAME = "NXP SABRE SD i.MX7 Dual"

IMAGE_FSTYPES += "ext3 sdcard"

BOOTFS_CONTENT = "\
    ${KERNEL_IMAGETYPE}:${KERNEL_IMAGETYPE} \
    ${KERNEL_IMAGETYPE}-imx7d-sdb.dtb:imx7d-sdb.dtb \
    ${KERNEL_IMAGETYPE}-imx7d-sdb-enet.dtb:imx7d-sdb-enet.dtb \
    ${KERNEL_IMAGETYPE}-imx7d-sdb-epdc.dtb:imx7d-sdb-epdc.dtb \
    ${KERNEL_IMAGETYPE}-imx7d-sdb-gpmi-weim.dtb:imx7d-sdb-gpmi-weim.dtb \
    ${KERNEL_IMAGETYPE}-imx7d-sdb-hdmi-audio.dtb:imx7d-sdb-hdmi-audio.dtb \
    ${KERNEL_IMAGETYPE}-imx7d-sdb-m4.dtb:imx7d-sdb-m4.dtb \
    ${KERNEL_IMAGETYPE}-imx7d-sdb-qspi.dtb:imx7d-sdb-qspi.dtb \
    ${KERNEL_IMAGETYPE}-imx7d-sdb-sim.dtb:imx7d-sdb-sim.dtb \
    ${KERNEL_IMAGETYPE}-imx7d-sdb-touch.dtb:imx7d-sdb-touch.dtb \
    ${KERNEL_IMAGETYPE}-imx7d-sdb-wm8960.dtb:imx7d-sdb-wm8960.dtb \
    u-boot-${MACHINE}.imx:u-boot.imx \
    "

BOOTFS_DEPENDS = "u-boot:do_deploy virtual/kernel:do_deploy"

DISTRO_FEATURES_remove = "webengine"

MACHINE_EXTRA_INSTALL = "\
        "

MACHINE_EXTRA_INSTALL_SDK = "\
        "
```

## conf/distro/include/intel-corei7-64.conf
```bitbake
############################################################################
##
## Copyright (C) 2016 The Qt Company Ltd.
## Contact: https://www.qt.io/licensing/
##
## This file is part of the Boot to Qt meta layer.
##
## $QT_BEGIN_LICENSE:GPL$
## Commercial License Usage
## Licensees holding valid commercial Qt licenses may use this file in
## accordance with the commercial license agreement provided with the
## Software or, alternatively, in accordance with the terms contained in
## a written agreement between you and The Qt Company. For licensing terms
## and conditions see https://www.qt.io/terms-conditions. For further
## information use the contact form at https://www.qt.io/contact-us.
##
## GNU General Public License Usage
## Alternatively, this file may be used under the terms of the GNU
## General Public License version 3 or (at your option) any later version
## approved by the KDE Free Qt Foundation. The licenses are as published by
## the Free Software Foundation and appearing in the file LICENSE.GPL3
## included in the packaging of this file. Please review the following
## information to ensure the GNU General Public License requirements will
## be met: https://www.gnu.org/licenses/gpl-3.0.html.
##
## $QT_END_LICENSE$
##
############################################################################

DEPLOY_CONF_NAME = "Intel NUC"

DISTRO_FEATURES_DEFAULT += "wayland weston"

DISTRO_FEATURES_remove = "usbgadget"

IMAGE_CLASSES += "image_dd_efi"
IMAGE_FSTYPES += "ext3 dd"

INITRAMFS_IMAGE = "initramfs-basic"

SYSVINIT_ENABLED_GETTYS = "1"

MACHINE_EXTRA_INSTALL = "\
        wayland \
        mesa-megadriver \
        grub-efi-config \
        "

MACHINE_EXTRA_INSTALL_SDK = " \
        mesa-dev \
        "
```
