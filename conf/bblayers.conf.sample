## conf/bblayers.conf.sample
```bitbake
#############################################################################
##
## Copyright (C) 2014 Digia Plc and/or its subsidiary(-ies).
##
## This file is part of the Qt Enterprise Embedded Scripts of the Qt
## framework.
##
## $QT_BEGIN_LICENSE$
## Commercial License Usage Only
## Licensees holding valid commercial Qt license agreements with Digia
## with an appropriate addendum covering the Qt Enterprise Embedded Scripts,
## may use this file in accordance with the terms contained in said license
## agreement.
##
## For further information use the contact form at
## http://qt.digia.com/contact-us.
##
##
## $QT_END_LICENSE$
##
#############################################################################

# LAYER_CONF_VERSION is increased each time build/conf/bblayers.conf
# changes incompatibly
LCONF_VERSION = "6"

BBPATH = "${TOPDIR}"
BBFILES ?= ""

BBLAYERS ?= " \
  ##COREBASE##/meta \
  ##COREBASE##/meta-yocto \
  ##COREBASE##/meta-fsl-arm \
  ##COREBASE##/meta-fsl-arm-extra \
  ##COREBASE##/meta-ti \
  ##COREBASE##/meta-raspberrypi \
  ##COREBASE##/meta-toradex \
  ##COREBASE##/meta-openembedded/meta-oe \
  ##COREBASE##/meta-b2qt \
  "
BBLAYERS_NON_REMOVABLE ?= " \
  ##COREBASE##/meta \
  ##COREBASE##/meta-yocto \
  "
```

## conf/distro/b2qt.conf
```bitbake
############################################################################
##
## Copyright (C) 2016 The Qt Company Ltd.
## Contact: https://www.qt.io/licensing/
##
## This file is part of the Boot to Qt meta layer.
##
## $QT_BEGIN_LICENSE:GPL$
## Commercial License Usage
## Licensees holding valid commercial Qt licenses may use this file in
## accordance with the commercial license agreement provided with the
## Software or, alternatively, in accordance with the terms contained in
## a written agreement between you and The Qt Company. For licensing terms
## and conditions see https://www.qt.io/terms-conditions. For further
## information use the contact form at https://www.qt.io/contact-us.
##
## GNU General Public License Usage
## Alternatively, this file may be used under the terms of the GNU
## General Public License version 3 or (at your option) any later version
## approved by the KDE Free Qt Foundation. The licenses are as published by
## the Free Software Foundation and appearing in the file LICENSE.GPL3
## included in the packaging of this file. Please review the following
## information to ensure the GNU General Public License requirements will
## be met: https://www.gnu.org/licenses/gpl-3.0.html.
##
## $QT_END_LICENSE$
##
############################################################################

include conf/distro/poky.conf

DISTRO = "b2qt"
DISTRO_NAME = "Boot to Qt for Embedded Linux"
SDK_VERSION := "${DISTRO_VERSION}"

SDK_MACHINE = "${@d.getVar('SDKMACHINE', True) or '${SDK_ARCH}'}"
SDK_NAME = "${DISTRO}-${SDK_MACHINE}-${IMAGE_BASENAME}"
TOOLCHAIN_OUTPUTNAME = "${SDK_NAME}-${MACHINE}"
BUILDCFG_VARS += "SDKMACHINE"

MAINTAINER = "B2Qt <B2Qt@digia.com>"

SANITY_TESTED_DISTROS += " \
            Ubuntu 11.04 \n \
            Ubuntu-15.10 \n \
            LinuxMint-14 \n \
            LinuxMint-16 \n \
            LinuxMint-17.1 \n \
            "

SYSVINIT_ENABLED_GETTYS = ""

DISTRO_FEATURES_DEFAULT = "alsa argp bluetooth ext2 largefile usbgadget usbhost wifi xattr nfs webengine"
POKY_DEFAULT_DISTRO_FEATURES = "largefile opengl multiarch"
DISTRO_FEATURES_BACKFILL_CONSIDERED = "pulseaudio sysvinit"

FONTCONFIG_CACHE_DIR = "${libdir}/fontconfig/cache"

# backport from oe/krogoth, needed by meta-qt5
PACKAGECONFIG_CONFARGS += "${EXTRA_OECONF}"

# use GStreamer 1.0, optionally change to "gstreamer010" to use GStreamer 0.10
DISTRO_FEATURES += "gstreamer"

DISTRO_FEATURES += "systemd"
VIRTUAL-RUNTIME_init_manager = "systemd"
VIRTUAL-RUNTIME_initscripts = ""
PREFERRED_PROVIDER_udev ?= "systemd"
PREFERRED_PROVIDER_udev-utils ?= "systemd"

PREFERRED_PROVIDER_jpeg ?= "libjpeg-turbo"
PREFERRED_PROVIDER_jpeg-native ?= "libjpeg-turbo-native"

MACHINE_EXTRA_INSTALL ?= ""
MACHINE_EXTRA_INSTALL_SDK ?= ""
MACHINE_EXTRA_INSTALL_SDK_HOST ?= ""

# Override mkspec for mingw build
OE_QMAKE_PLATFORM_NATIVE_mingw32 = "win32-g++-oe"
OE_QMAKE_PLATFORM_mingw32 = "win32-g++-oe"

# Disable SHA validation for branch
QT_MODULE_BRANCH_PARAM = "nobranch=1"

PACKAGE_EXCLUDE_COMPLEMENTARY ?= "qtquickcompiler"

IMAGE_FSTYPES = "tar.gz conf"
IMAGE_CLASSES += "image_types_sdcard deploy-conf"

LICENSE_CREATE_PACKAGE = "1"
COPY_LIC_MANIFEST = "1"

include conf/distro/include/${MACHINE}.conf
```

## conf/distro/include/am335x-evm.conf
```bitbake
############################################################################
##
## Copyright (C) 2016 The Qt Company Ltd.
## Contact: https://www.qt.io/licensing/
##
## This file is part of the Boot to Qt meta layer.
##
## $QT_BEGIN_LICENSE:GPL$
## Commercial License Usage
## Licensees holding valid commercial Qt licenses may use this file in
## accordance with the commercial license agreement provided with the
## Software or, alternatively, in accordance with the terms contained in
## a written agreement between you and The Qt Company. For licensing terms
## and conditions see https://www.qt.io/terms-conditions. For further
## information use the contact form at https://www.qt.io/contact-us.
##
## GNU General Public License Usage
## Alternatively, this file may be used under the terms of the GNU
## General Public License version 3 or (at your option) any later version
## approved by the KDE Free Qt Foundation. The licenses are as published by
## the Free Software Foundation and appearing in the file LICENSE.GPL3
## included in the packaging of this file. Please review the following
## information to ensure the GNU General Public License requirements will
## be met: https://www.gnu.org/licenses/gpl-3.0.html.
##
## $QT_END_LICENSE$
##
############################################################################

include conf/distro/include/ti.inc

DEPLOY_CONF_NAME = "Sitara AM335x Starter Kit"

BOOTFS_CONTENT = "\
    u-boot-${MACHINE}.img:u-boot.img \
    MLO-${MACHINE}:MLO \
    "
BOOTFS_DEPENDS = "u-boot:do_deploy"

DISTRO_FEATURES_remove = "webengine"

PREFERRED_VERSION_linux-ti-staging = "3.14%"

PREFERRED_PROVIDER_virtual/egl = "libgles-omap3"
PREFERRED_PROVIDER_virtual/libgles2 = "libgles-omap3"

PREFERRED_VERSION_libgles-omap3 = "5.01.01.02"
PREFERRED_VERSION_omap3-sgx-modules = "5.01.01.02"

MACHINE_EXTRA_INSTALL = "\
        libgles-omap3 \
        libgles-omap3-rawdemos \
        lighttpd \
        "

MACHINE_EXTRA_INSTALL_SDK = "\
        libgles-omap3-dev \
        "
```

## conf/distro/include/apalis-imx6.conf
```bitbake
##############################################################################
##
## Copyright (C) 2016 The Qt Company Ltd.
## Contact: http://www.qt.io/licensing/
##
## This file is part of the Boot to Qt meta layer.
##
## $QT_BEGIN_LICENSE:COMM$
##
## Commercial License Usage
## Licensees holding valid commercial Qt licenses may use this file in
## accordance with the commercial license agreement provided with the
## Software or, alternatively, in accordance with the terms contained in
## a written agreement between you and The Qt Company. For licensing terms
## and conditions see http://www.qt.io/terms-conditions. For further
## information use the contact form at http://www.qt.io/contact-us.
##
## $QT_END_LICENSE$
##
##############################################################################

include conf/distro/include/toradex.inc
include conf/distro/include/imx6.inc

DEPLOY_CONF_NAME = "Toradex Apalis iMX6"

KERNEL_IMAGETYPE = "uImage"

BOOTFS_CONTENT = "\
    ${KERNEL_IMAGETYPE}:${KERNEL_IMAGETYPE} \
    ${KERNEL_IMAGETYPE}-imx6q-apalis-eval.dtb:imx6q-apalis-eval.dtb \
    ${KERNEL_IMAGETYPE}-imx6q-apalis-ixora.dtb:imx6q-apalis-ixora.dtb \
    ${KERNEL_IMAGETYPE}-imx6q-apalis_v1_0-eval.dtb:imx6q-apalis_v1_0-eval.dtb \
    ${KERNEL_IMAGETYPE}-imx6q-apalis_v1_0-ixora.dtb:imx6q-apalis_v1_0-ixora.dtb \
    u-boot-${MACHINE}.imx:u-boot.imx \
    flash_mmc-${MACHINE}.img:flash_mmc.img \
    flash_blk-${MACHINE}.img:flash_blk.img \
    "
BOOTFS_DEPENDS = "u-boot:do_deploy u-boot-script-toradex:do_deploy virtual/kernel:do_deploy"
BOOT_SCRIPTS += " \
    u-boot-${MACHINE}.imx:u-boot.imx \
    flash_mmc-${MACHINE}.img:flash_mmc.img \
    flash_blk-${MACHINE}.img:flash_blk.img \
    "

MACHINE_EXTRA_INSTALL = "\
        libgal-mx6 \
        libegl-mx6 \
        libgles2-mx6 \
        ${@base_contains("DISTRO_FEATURES", "gstreamer010", "gst-fsl-plugin", "", d)} \
        ${@base_contains("DISTRO_FEATURES", "gstreamer", "gstreamer1.0-plugins-imx-meta", "", d)} \
        "

MACHINE_EXTRA_INSTALL_SDK += " \
        libgal-mx6 \
        libegl-mx6 \
        libegl-mx6-dev \
        libgles2-mx6 \
        libgles2-mx6-dev \
        "

SERIAL_CONSOLES = "115200;ttymxc0 \
                   115200;ttymxc1"
```

## conf/distro/include/beagleboard.conf
```bitbake
##############################################################################
##
## Copyright (C) 2016 The Qt Company Ltd.
## Contact: http://www.qt.io/licensing/
##
## This file is part of the Boot to Qt meta layer.
##
## $QT_BEGIN_LICENSE:COMM$
##
## Commercial License Usage
## Licensees holding valid commercial Qt licenses may use this file in
## accordance with the commercial license agreement provided with the
## Software or, alternatively, in accordance with the terms contained in
## a written agreement between you and The Qt Company. For licensing terms
## and conditions see http://www.qt.io/terms-conditions. For further
## information use the contact form at http://www.qt.io/contact-us.
##
## $QT_END_LICENSE$
##
##############################################################################

include conf/distro/include/ti.inc

DEPLOY_CONF_NAME = "BeagleBoard"

BOOTFS_CONTENT = "\
    u-boot-${MACHINE}.img:u-boot.img \
    MLO-${MACHINE}:MLO \
    "
BOOTFS_DEPENDS = "u-boot:do_deploy"

PREFERRED_PROVIDER_virtual/egl = "libgles-omap3"
PREFERRED_PROVIDER_virtual/libgles2 = "libgles-omap3"

PREFERRED_VERSION_libgles-omap3 = "4.09.00.01"
PREFERRED_VERSION_omap3-sgx-modules = "4.09.00.01"

MACHINE_EXTRA_INSTALL = "\
        libgles-omap3 \
        libgles-omap3-rawdemos \
        "

MACHINE_EXTRA_INSTALL_SDK = "\
        libgles-omap3-dev \
        "

ADB_PRODUCTID = "0x9018"
```

## conf/distro/include/beaglebone.conf
```bitbake
##############################################################################
##
## Copyright (C) 2016 The Qt Company Ltd.
## Contact: http://www.qt.io/licensing/
##
## This file is part of the Boot to Qt meta layer.
##
## $QT_BEGIN_LICENSE:COMM$
##
## Commercial License Usage
## Licensees holding valid commercial Qt licenses may use this file in
## accordance with the commercial license agreement provided with the
## Software or, alternatively, in accordance with the terms contained in
## a written agreement between you and The Qt Company. For licensing terms
## and conditions see http://www.qt.io/terms-conditions. For further
## information use the contact form at http://www.qt.io/contact-us.
##
## $QT_END_LICENSE$
##
##############################################################################

include conf/distro/include/ti.inc

DEPLOY_CONF_NAME = "BeagleBone Black"

BOOTFS_CONTENT = "\
    u-boot-${MACHINE}.img:u-boot.img \
    MLO-${MACHINE}:MLO \
    uEnv-${MACHINE}.txt:uEnv.txt \
    "
BOOTFS_DEPENDS = "u-boot:do_deploy u-boot-uenv-script:do_deploy"

EXTRA_IMAGEDEPENDS += "u-boot-uenv-script"

DISTRO_FEATURES_remove = "webengine"

PREFERRED_VERSION_libgles-omap3 = "4.10.00.01"
PREFERRED_VERSION_omap3-sgx-modules = "4.10.00.01"

PREFERRED_PROVIDER_virtual/egl = "libgles-omap3"
PREFERRED_PROVIDER_virtual/libgles2 = "libgles-omap3"

PREFERRED_PROVIDER_u-boot = "u-boot-ti-staging"
EXTRA_IMAGEDEPENDS_remove = "u-boot-denx"
UBOOT_MACHINE = "am335x_boneblack_config"
KERNEL_IMAGETYPE = "zImage"

MACHINE_EXTRA_INSTALL = "\
        libgles-omap3 \
        libgles-omap3-rawdemos \
        "

MACHINE_EXTRA_INSTALL_SDK = "\
        libgles-omap3-dev \
        "

ADB_PRODUCTID = "0xD002"

DEFAULTTUNE = "armv7ahf-neon"
```

## conf/distro/include/colibri-imx6.conf
```bitbake
############################################################################
##
## Copyright (C) 2016 The Qt Company Ltd.
## Contact: https://www.qt.io/licensing/
##
## This file is part of the Boot to Qt meta layer.
##
## $QT_BEGIN_LICENSE:GPL$
## Commercial License Usage
## Licensees holding valid commercial Qt licenses may use this file in
## accordance with the commercial license agreement provided with the
## Software or, alternatively, in accordance with the terms contained in
## a written agreement between you and The Qt Company. For licensing terms
## and conditions see https://www.qt.io/terms-conditions. For further
## information use the contact form at https://www.qt.io/contact-us.
##
## GNU General Public License Usage
## Alternatively, this file may be used under the terms of the GNU
## General Public License version 3 or (at your option) any later version
## approved by the KDE Free Qt Foundation. The licenses are as published by
## the Free Software Foundation and appearing in the file LICENSE.GPL3
## included in the packaging of this file. Please review the following
## information to ensure the GNU General Public License requirements will
## be met: https://www.gnu.org/licenses/gpl-3.0.html.
##
## $QT_END_LICENSE$
##
############################################################################

include conf/distro/include/toradex.inc
include conf/distro/include/imx6.inc
include conf/distro/include/imx6-egl.inc

DEPLOY_CONF_NAME = "Toradex Colibri iMX6"

KERNEL_IMAGETYPE = "uImage"

BOOTFS_CONTENT = "\
    ${KERNEL_IMAGETYPE}:${KERNEL_IMAGETYPE} \
    ${KERNEL_IMAGETYPE}-imx6dl-colibri-eval-v3.dtb:imx6dl-colibri-eval-v3.dtb \
    ${KERNEL_IMAGETYPE}-imx6dl-colibri-cam-eval-v3.dtb:imx6dl-colibri-cam-eval-v3.dtb \
    u-boot-${MACHINE}.imx:u-boot.imx \
    "
BOOTFS_DEPENDS = "u-boot:do_deploy u-boot-script-toradex:do_deploy virtual/kernel:do_deploy"
BOOT_SCRIPTS += " \
    u-boot-${MACHINE}.imx:u-boot.imx \
    flash_mmc-${MACHINE}.img:flash_mmc.img \
    flash_blk-${MACHINE}.img:flash_blk.img \
    "
```

## conf/distro/include/colibri-imx7.conf
```bitbake
#############################################################################
##
## Copyright (C) 2014 Digia Plc and/or its subsidiary(-ies).
##
## This file is part of the Qt Enterprise Embedded Scripts of the Qt
## framework.
##
## $QT_BEGIN_LICENSE$
## Commercial License Usage Only
## Licensees holding valid commercial Qt license agreements with Digia
## with an appropriate addendum covering the Qt Enterprise Embedded Scripts,
## may use this file in accordance with the terms contained in said license
## agreement.
##
## For further information use the contact form at
## http://www.qt.io/contact-us.
##
##
## $QT_END_LICENSE$
##
#############################################################################

include conf/distro/include/toradex.inc

DEPLOY_CONF_NAME = "Toradex Colibri iMX7"

IMAGE_FSTYPES += "ext3 sdcard"

BOOTFS_CONTENT = "\
    ${KERNEL_IMAGETYPE}:${KERNEL_IMAGETYPE} \
    ${KERNEL_IMAGETYPE}-imx7d-colibri-eval-v3.dtb:imx7d-colibri-eval-v3.dtb \
    ${KERNEL_IMAGETYPE}-imx7s-colibri-eval-v3.dtb:imx7s-colibri-eval-v3.dtb \
    u-boot-${MACHINE}.imx:u-boot.imx \
    "
BOOTFS_DEPENDS = "u-boot:do_deploy virtual/kernel:do_deploy"

DISTRO_FEATURES_remove = "webengine"
```
