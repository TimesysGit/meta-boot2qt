## conf/distro/include/toradex.inc
```bitbake
##############################################################################
##
## Copyright (C) 2016 The Qt Company Ltd.
## Contact: http://www.qt.io/licensing/
##
## This file is part of the Boot to Qt meta layer.
##
## $QT_BEGIN_LICENSE:COMM$
##
## Commercial License Usage
## Licensees holding valid commercial Qt licenses may use this file in
## accordance with the commercial license agreement provided with the
## Software or, alternatively, in accordance with the terms contained in
## a written agreement between you and The Qt Company. For licensing terms
## and conditions see http://www.qt.io/terms-conditions. For further
## information use the contact form at http://www.qt.io/contact-us.
##
## $QT_END_LICENSE$
##
##############################################################################

BBMASK ?= " "
BBMASK .= "|meta-toradex/recipes-mozilla|meta-toradex/recipes-browser|meta-toradex/recipes-lxde|meta-toradex/recipes-connectivity|meta-toradex/recipes-gnome|meta-toradex/recipes/trdx-config|meta-toradex/recipes-multimedia/webm|meta-toradex/recipes-qt|meta-toradex/recipes-core/psplash|meta-toradex/recipes-support/florence|meta-toradex/recipes-core/systemd|meta-toradex/recipes-efl|meta-toradex/recipes-core/dropbear|meta-toradex/recipes-support/icu|meta-toradex/recipes-support/i2c-tools|meta-toradex/recipes-benchmark|meta-toradex/recipes-core/udev|meta-toradex/recipes-support/gnutls|meta-toradex/recipes-graphics/gpu-viv-bin-mx6q|meta-toradex/recipes-multimedia/gstreamer|meta-toradex/recipes-fsl/packagegroups|recipes-core/glibc/glibc_linaro-2.20.bbappend"

PREFERRED_PROVIDER_u-boot = "u-boot-toradex"

MACHINEDIR = "${@d.getVar('MACHINE', True).replace('-','_')}"
BOOT_SCRIPTS += " \
    fwd_blk.img:flash_blk.img \
    fwd_eth.img:flash_eth.img \
    fwd_mmc.img:flash_mmc.img \
    ${MACHINE}:${MACHINEDIR} \
    u-boot-${MACHINE}.imx:${MACHINEDIR}/u-boot.imx \
    "
```

## conf/layer.conf
```bitbake
##############################################################################
##
## Copyright (C) 2016 The Qt Company Ltd.
## Contact: http://www.qt.io/licensing/
##
## This file is part of the Boot to Qt meta layer.
##
## $QT_BEGIN_LICENSE:COMM$
##
## Commercial License Usage
## Licensees holding valid commercial Qt licenses may use this file in
## accordance with the commercial license agreement provided with the
## Software or, alternatively, in accordance with the terms contained in
## a written agreement between you and The Qt Company. For licensing terms
## and conditions see http://www.qt.io/terms-conditions. For further
## information use the contact form at http://www.qt.io/contact-us.
##
## $QT_END_LICENSE$
##
##############################################################################

# We have a conf and classes directory, append to BBPATH
BBPATH .= ":${LAYERDIR}"

# We have a recipes directory, add to BBFILES
BBFILES += "${LAYERDIR}/recipes/*/*.bb \
            ${LAYERDIR}/recipes/*/*.bbappend \
            "
BBFILES += "${@bb.utils.contains("BBFILE_COLLECTIONS", "qt5-layer", "${LAYERDIR}/recipes-qt/*/*.bb ${LAYERDIR}/recipes-qt/*/*.bbappend" , "", d)}"

BBFILE_COLLECTIONS += "b2qt"
BBFILE_PATTERN_b2qt := "^${LAYERDIR}/"
BBFILE_PRIORITY_b2qt = "20"

LICENSE_PATH += "${LAYERDIR}/licenses"
QT_LICENCE = "${LAYERDIR}/licenses/QtEnterprise"
B2QTBASE = "${LAYERDIR}"
```

## conf/machine/emulator.conf
```bitbake
############################################################################
##
## Copyright (C) 2016 The Qt Company Ltd.
## Contact: https://www.qt.io/licensing/
##
## This file is part of the Boot to Qt meta layer.
##
## $QT_BEGIN_LICENSE:GPL$
## Commercial License Usage
## Licensees holding valid commercial Qt licenses may use this file in
## accordance with the commercial license agreement provided with the
## Software or, alternatively, in accordance with the terms contained in
## a written agreement between you and The Qt Company. For licensing terms
## and conditions see https://www.qt.io/terms-conditions. For further
## information use the contact form at https://www.qt.io/contact-us.
##
## GNU General Public License Usage
## Alternatively, this file may be used under the terms of the GNU
## General Public License version 3 or (at your option) any later version
## approved by the KDE Free Qt Foundation. The licenses are as published by
## the Free Software Foundation and appearing in the file LICENSE.GPL3
## included in the packaging of this file. Please review the following
## information to ensure the GNU General Public License requirements will
## be met: https://www.gnu.org/licenses/gpl-3.0.html.
##
## $QT_END_LICENSE$
##
############################################################################

#@TYPE: Machine
#@NAME: virtual box emulator
#@DESCRIPTION: Machine configuration for running a common x86

PREFERRED_PROVIDER_virtual/libgl ?= "mesa"
PREFERRED_PROVIDER_virtual/libgles1 ?= "mesa"
PREFERRED_PROVIDER_virtual/libgles2 ?= "mesa"

PREFERRED_PROVIDER_virtual/kernel ?= "linux-yocto"

require conf/machine/include/tune-i586.inc

KERNEL_IMAGETYPE = "bzImage"

SERIAL_CONSOLE = "115200 ttyS0"

MACHINE_FEATURES += "x86"

MACHINE_ESSENTIAL_EXTRA_RDEPENDS += "v86d virtualbox-guest-additions"

MACHINE_FEATURES += "apm alsa pcmcia bluetooth irda usbgadget screen"
```
